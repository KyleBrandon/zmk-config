## config/west.yml
```yaml
manifest:
  remotes:
    - name: keb-corne
      url-base: https://github.com/KyleBrandon
  projects:
    - name: zmk
      remote: keb-corne
      revision: kyle-corne
      import: app/west.yml
  self:
    path: config
```
